## zyphyrproject/build/Kconfig/soc/Kconfig.sysbuild
```kconfig
# Load Sysbuild SoC Kconfig descriptions.
osource "C:/Users/axelo/Documents/Plugg/Embeded1/zyphyrproject/zephyr/soc/xlnx/zynqmp/Kconfig.sysbuild"
osource "C:/Users/axelo/Documents/Plugg/Embeded1/zyphyrproject/zephyr/soc/xlnx/zynq7000/Kconfig.sysbuild"
osource "C:/Users/axelo/Documents/Plugg/Embeded1/zyphyrproject/zephyr/soc/xen/Kconfig.sysbuild"
osource "C:/Users/axelo/Documents/Plugg/Embeded1/zyphyrproject/zephyr/soc/wch/ch32v/Kconfig.sysbuild"
osource "C:/Users/axelo/Documents/Plugg/Embeded1/zyphyrproject/zephyr/soc/ti/simplelink/Kconfig.sysbuild"
osource "C:/Users/axelo/Documents/Plugg/Embeded1/zyphyrproject/zephyr/soc/ti/lm3s6965/Kconfig.sysbuild"
osource "C:/Users/axelo/Documents/Plugg/Embeded1/zyphyrproject/zephyr/soc/ti/k3/Kconfig.sysbuild"
osource "C:/Users/axelo/Documents/Plugg/Embeded1/zyphyrproject/zephyr/soc/telink/tlsr/Kconfig.sysbuild"
osource "C:/Users/axelo/Documents/Plugg/Embeded1/zyphyrproject/zephyr/soc/starfive/jh71xx/Kconfig.sysbuild"
osource "C:/Users/axelo/Documents/Plugg/Embeded1/zyphyrproject/zephyr/soc/st/stm32/Kconfig.sysbuild"
osource "C:/Users/axelo/Documents/Plugg/Embeded1/zyphyrproject/zephyr/soc/snps/qemu_arc/Kconfig.sysbuild"
osource "C:/Users/axelo/Documents/Plugg/Embeded1/zyphyrproject/zephyr/soc/snps/nsim/arc_v/Kconfig.sysbuild"
osource "C:/Users/axelo/Documents/Plugg/Embeded1/zyphyrproject/zephyr/soc/snps/nsim/arc_classic/Kconfig.sysbuild"
osource "C:/Users/axelo/Documents/Plugg/Embeded1/zyphyrproject/zephyr/soc/snps/hsdk4xd/Kconfig.sysbuild"
osource "C:/Users/axelo/Documents/Plugg/Embeded1/zyphyrproject/zephyr/soc/snps/hsdk/Kconfig.sysbuild"
osource "C:/Users/axelo/Documents/Plugg/Embeded1/zyphyrproject/zephyr/soc/snps/emsk/Kconfig.sysbuild"
osource "C:/Users/axelo/Documents/Plugg/Embeded1/zyphyrproject/zephyr/soc/snps/emsdp/Kconfig.sysbuild"
osource "C:/Users/axelo/Documents/Plugg/Embeded1/zyphyrproject/zephyr/soc/snps/arc_iot/Kconfig.sysbuild"
osource "C:/Users/axelo/Documents/Plugg/Embeded1/zyphyrproject/zephyr/soc/silabs/Kconfig.sysbuild"
osource "C:/Users/axelo/Documents/Plugg/Embeded1/zyphyrproject/zephyr/soc/sifive/sifive_freedom/Kconfig.sysbuild"
osource "C:/Users/axelo/Documents/Plugg/Embeded1/zyphyrproject/zephyr/soc/sensry/Kconfig.sysbuild"
osource "C:/Users/axelo/Documents/Plugg/Embeded1/zyphyrproject/zephyr/soc/rockchip/Kconfig.sysbuild"
osource "C:/Users/axelo/Documents/Plugg/Embeded1/zyphyrproject/zephyr/soc/renode/riscv_virtual/Kconfig.sysbuild"
osource "C:/Users/axelo/Documents/Plugg/Embeded1/zyphyrproject/zephyr/soc/renode/cortex_r8_virtual/Kconfig.sysbuild"
osource "C:/Users/axelo/Documents/Plugg/Embeded1/zyphyrproject/zephyr/soc/renesas/smartbond/Kconfig.sysbuild"
osource "C:/Users/axelo/Documents/Plugg/Embeded1/zyphyrproject/zephyr/soc/renesas/rzt2m/Kconfig.sysbuild"
osource "C:/Users/axelo/Documents/Plugg/Embeded1/zyphyrproject/zephyr/soc/renesas/rz/Kconfig.sysbuild"
osource "C:/Users/axelo/Documents/Plugg/Embeded1/zyphyrproject/zephyr/soc/renesas/rcar/Kconfig.sysbuild"
osource "C:/Users/axelo/Documents/Plugg/Embeded1/zyphyrproject/zephyr/soc/renesas/ra/Kconfig.sysbuild"
osource "C:/Users/axelo/Documents/Plugg/Embeded1/zyphyrproject/zephyr/soc/realtek/ec/Kconfig.sysbuild"
osource "C:/Users/axelo/Documents/Plugg/Embeded1/zyphyrproject/zephyr/soc/raspberrypi/rpi_pico/Kconfig.sysbuild"
osource "C:/Users/axelo/Documents/Plugg/Embeded1/zyphyrproject/zephyr/soc/quicklogic/eos_s3/Kconfig.sysbuild"
osource "C:/Users/axelo/Documents/Plugg/Embeded1/zyphyrproject/zephyr/soc/qemu/virt_riscv/Kconfig.sysbuild"
osource "C:/Users/axelo/Documents/Plugg/Embeded1/zyphyrproject/zephyr/soc/qemu/malta/Kconfig.sysbuild"
osource "C:/Users/axelo/Documents/Plugg/Embeded1/zyphyrproject/zephyr/soc/openisa/rv32m1/Kconfig.sysbuild"
osource "C:/Users/axelo/Documents/Plugg/Embeded1/zyphyrproject/zephyr/soc/nxp/s32/Kconfig.sysbuild"
osource "C:/Users/axelo/Documents/Plugg/Embeded1/zyphyrproject/zephyr/soc/nxp/rw/Kconfig.sysbuild"
osource "C:/Users/axelo/Documents/Plugg/Embeded1/zyphyrproject/zephyr/soc/nxp/mcx/Kconfig.sysbuild"
osource "C:/Users/axelo/Documents/Plugg/Embeded1/zyphyrproject/zephyr/soc/nxp/lpc/Kconfig.sysbuild"
osource "C:/Users/axelo/Documents/Plugg/Embeded1/zyphyrproject/zephyr/soc/nxp/layerscape/Kconfig.sysbuild"
osource "C:/Users/axelo/Documents/Plugg/Embeded1/zyphyrproject/zephyr/soc/nxp/kinetis/Kconfig.sysbuild"
osource "C:/Users/axelo/Documents/Plugg/Embeded1/zyphyrproject/zephyr/soc/nxp/imxrt/Kconfig.sysbuild"
osource "C:/Users/axelo/Documents/Plugg/Embeded1/zyphyrproject/zephyr/soc/nxp/imx/Kconfig.sysbuild"
osource "C:/Users/axelo/Documents/Plugg/Embeded1/zyphyrproject/zephyr/soc/nuvoton/numicro/Kconfig.sysbuild"
osource "C:/Users/axelo/Documents/Plugg/Embeded1/zyphyrproject/zephyr/soc/nuvoton/numaker/Kconfig.sysbuild"
osource "C:/Users/axelo/Documents/Plugg/Embeded1/zyphyrproject/zephyr/soc/nuvoton/npcx/Kconfig.sysbuild"
osource "C:/Users/axelo/Documents/Plugg/Embeded1/zyphyrproject/zephyr/soc/nuvoton/npcm/Kconfig.sysbuild"
osource "C:/Users/axelo/Documents/Plugg/Embeded1/zyphyrproject/zephyr/soc/nordic/Kconfig.sysbuild"
osource "C:/Users/axelo/Documents/Plugg/Embeded1/zyphyrproject/zephyr/soc/neorv32/Kconfig.sysbuild"
osource "C:/Users/axelo/Documents/Plugg/Embeded1/zyphyrproject/zephyr/soc/native/inf_clock/Kconfig.sysbuild"
osource "C:/Users/axelo/Documents/Plugg/Embeded1/zyphyrproject/zephyr/soc/microchip/miv/Kconfig.sysbuild"
osource "C:/Users/axelo/Documents/Plugg/Embeded1/zyphyrproject/zephyr/soc/microchip/mec/Kconfig.sysbuild"
osource "C:/Users/axelo/Documents/Plugg/Embeded1/zyphyrproject/zephyr/soc/mediatek/mt8xxx/Kconfig.sysbuild"
osource "C:/Users/axelo/Documents/Plugg/Embeded1/zyphyrproject/zephyr/soc/lowrisc/opentitan/Kconfig.sysbuild"
osource "C:/Users/axelo/Documents/Plugg/Embeded1/zyphyrproject/zephyr/soc/litex/litex_vexriscv/Kconfig.sysbuild"
osource "C:/Users/axelo/Documents/Plugg/Embeded1/zyphyrproject/zephyr/soc/ite/ec/Kconfig.sysbuild"
osource "C:/Users/axelo/Documents/Plugg/Embeded1/zyphyrproject/zephyr/soc/intel/raptor_lake/Kconfig.sysbuild"
osource "C:/Users/axelo/Documents/Plugg/Embeded1/zyphyrproject/zephyr/soc/intel/lakemont/Kconfig.sysbuild"
osource "C:/Users/axelo/Documents/Plugg/Embeded1/zyphyrproject/zephyr/soc/intel/intel_socfpga_std/Kconfig.sysbuild"
osource "C:/Users/axelo/Documents/Plugg/Embeded1/zyphyrproject/zephyr/soc/intel/intel_socfpga/Kconfig.sysbuild"
osource "C:/Users/axelo/Documents/Plugg/Embeded1/zyphyrproject/zephyr/soc/intel/intel_niosv/Kconfig.sysbuild"
osource "C:/Users/axelo/Documents/Plugg/Embeded1/zyphyrproject/zephyr/soc/intel/intel_ish/Kconfig.sysbuild"
osource "C:/Users/axelo/Documents/Plugg/Embeded1/zyphyrproject/zephyr/soc/intel/intel_adsp/Kconfig.sysbuild"
osource "C:/Users/axelo/Documents/Plugg/Embeded1/zyphyrproject/zephyr/soc/intel/elkhart_lake/Kconfig.sysbuild"
osource "C:/Users/axelo/Documents/Plugg/Embeded1/zyphyrproject/zephyr/soc/intel/atom/Kconfig.sysbuild"
osource "C:/Users/axelo/Documents/Plugg/Embeded1/zyphyrproject/zephyr/soc/intel/apollo_lake/Kconfig.sysbuild"
osource "C:/Users/axelo/Documents/Plugg/Embeded1/zyphyrproject/zephyr/soc/intel/alder_lake/Kconfig.sysbuild"
osource "C:/Users/axelo/Documents/Plugg/Embeded1/zyphyrproject/zephyr/soc/infineon/cat3/Kconfig.sysbuild"
osource "C:/Users/axelo/Documents/Plugg/Embeded1/zyphyrproject/zephyr/soc/infineon/cat1b/Kconfig.sysbuild"
osource "C:/Users/axelo/Documents/Plugg/Embeded1/zyphyrproject/zephyr/soc/infineon/cat1a/Kconfig.sysbuild"
osource "C:/Users/axelo/Documents/Plugg/Embeded1/zyphyrproject/zephyr/soc/gd/gd32/Kconfig.sysbuild"
osource "C:/Users/axelo/Documents/Plugg/Embeded1/zyphyrproject/zephyr/soc/gaisler/leon3/Kconfig.sysbuild"
osource "C:/Users/axelo/Documents/Plugg/Embeded1/zyphyrproject/zephyr/soc/gaisler/gr716a/Kconfig.sysbuild"
osource "C:/Users/axelo/Documents/Plugg/Embeded1/zyphyrproject/zephyr/soc/espressif/Kconfig.sysbuild"
osource "C:/Users/axelo/Documents/Plugg/Embeded1/zyphyrproject/zephyr/soc/ene/kb1200/Kconfig.sysbuild"
osource "C:/Users/axelo/Documents/Plugg/Embeded1/zyphyrproject/zephyr/soc/efinix/sapphire/Kconfig.sysbuild"
osource "C:/Users/axelo/Documents/Plugg/Embeded1/zyphyrproject/zephyr/soc/cdns/xtensa_sample_controller/Kconfig.sysbuild"
osource "C:/Users/axelo/Documents/Plugg/Embeded1/zyphyrproject/zephyr/soc/cdns/sample_controller32/Kconfig.sysbuild"
osource "C:/Users/axelo/Documents/Plugg/Embeded1/zyphyrproject/zephyr/soc/cdns/dc233c/Kconfig.sysbuild"
osource "C:/Users/axelo/Documents/Plugg/Embeded1/zyphyrproject/zephyr/soc/brcm/bcmvk/Kconfig.sysbuild"
osource "C:/Users/axelo/Documents/Plugg/Embeded1/zyphyrproject/zephyr/soc/brcm/bcm2712/Kconfig.sysbuild"
osource "C:/Users/axelo/Documents/Plugg/Embeded1/zyphyrproject/zephyr/soc/brcm/bcm2711/Kconfig.sysbuild"
osource "C:/Users/axelo/Documents/Plugg/Embeded1/zyphyrproject/zephyr/soc/atmel/sam0/Kconfig.sysbuild"
osource "C:/Users/axelo/Documents/Plugg/Embeded1/zyphyrproject/zephyr/soc/atmel/sam/Kconfig.sysbuild"
osource "C:/Users/axelo/Documents/Plugg/Embeded1/zyphyrproject/zephyr/soc/aspeed/Kconfig.sysbuild"
osource "C:/Users/axelo/Documents/Plugg/Embeded1/zyphyrproject/zephyr/soc/arm/Kconfig.sysbuild"
osource "C:/Users/axelo/Documents/Plugg/Embeded1/zyphyrproject/zephyr/soc/arm/beetle/Kconfig.sysbuild"
osource "C:/Users/axelo/Documents/Plugg/Embeded1/zyphyrproject/zephyr/soc/antmicro/myra/Kconfig.sysbuild"
osource "C:/Users/axelo/Documents/Plugg/Embeded1/zyphyrproject/zephyr/soc/andestech/Kconfig.sysbuild"
osource "C:/Users/axelo/Documents/Plugg/Embeded1/zyphyrproject/zephyr/soc/amd/acp_6_0/Kconfig.sysbuild"
osource "C:/Users/axelo/Documents/Plugg/Embeded1/zyphyrproject/zephyr/soc/ambiq/Kconfig.sysbuild"
osource "C:/Users/axelo/Documents/Plugg/Embeded1/zyphyrproject/zephyr/soc/altr/zephyr_nios2f/Kconfig.sysbuild"
osource "C:/Users/axelo/Documents/Plugg/Embeded1/zyphyrproject/zephyr/soc/altr/qemu_nios2/Kconfig.sysbuild"
osource "C:/Users/axelo/Documents/Plugg/Embeded1/zyphyrproject/zephyr/soc/adi/max32/Kconfig.sysbuild"
```

## zyphyrproject/lab2_rtos_basics_template-main/part1/build/Kconfig/boards/Kconfig
```kconfig
# Load Zephyr board Kconfig descriptions.
osource "C:/Users/axelo/Documents/Plugg/Embeded1/zyphyrproject/zephyr/boards/raspberrypi/rpi_pico/Kconfig"
```

## zyphyrproject/lab2_rtos_basics_template-main/part1/build/Kconfig/boards/Kconfig.defconfig
```kconfig
# Load Zephyr board defconfig descriptions.
osource "C:/Users/axelo/Documents/Plugg/Embeded1/zyphyrproject/zephyr/boards/raspberrypi/rpi_pico/Kconfig.defconfig"
```
